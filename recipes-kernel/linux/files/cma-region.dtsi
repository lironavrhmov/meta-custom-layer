/ {
    reserved-memory {
        #address-cells = <2>;
        #size-cells = <2>;
        ranges;

        linux,cma {
            compatible = "shared-dma-pool";
            reusable;
            size = <0x0 0x08000000>; /* 128MB */
            alloc-ranges = <0x0 0x40000000 0x0 0x40000000>; /* מתחיל מכתובת 1GB */
            linux,cma-default;
        };
    };
};